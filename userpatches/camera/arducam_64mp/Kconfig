## userpatches/camera/arducam_64mp/Kconfig
```kconfig
config VIDEO_ARDUCAM_64MP
	tristate "Arducam 64 MP camera support"
	depends on I2C && VIDEO_DEV
	depends on MEDIA_CAMERA_SUPPORT
	select MEDIA_CONTROLLER
	select VIDEO_V4L2_SUBDEV_API
	select V4L2_FWNODE
	help
	  Raspberry Pi's driver for the Arducam 64 MP camera (2 MIPI CSI-2
	  lanes), with the bus configuration and frame interval calls the
	  Rockchip CSI-2 D-PHY and ISP drivers need.

	  The module is called arducam_64mp.
```

## userpatches/camera/imx283/Kconfig
```kconfig
config VIDEO_IMX283
	tristate "Sony IMX283 sensor support (1-inch 20 MP)"
	depends on I2C && VIDEO_DEV
	depends on MEDIA_CAMERA_SUPPORT
	select MEDIA_CONTROLLER
	select VIDEO_V4L2_SUBDEV_API
	select V4L2_FWNODE
	select REGMAP_I2C
	help
	  Raspberry Pi's driver for the Sony IMX283 (4 MIPI CSI-2 lanes),
	  backported to Linux 6.1, with the bus configuration and frame
	  interval calls the Rockchip CSI-2 D-PHY and ISP drivers need.

	  The module is called imx283.
```

## userpatches/camera/imx296/Kconfig
```kconfig
config VIDEO_IMX296
	tristate "Sony IMX296 sensor support (Raspberry Pi Global Shutter Camera)"
	depends on I2C && VIDEO_DEV
	depends on MEDIA_CAMERA_SUPPORT
	select MEDIA_CONTROLLER
	select VIDEO_V4L2_SUBDEV_API
	select V4L2_FWNODE
	select REGMAP_I2C
	help
	  The Sony IMX296 driver from Raspberry Pi's kernel (1 MIPI CSI-2
	  lane, global shutter), with the bus configuration, frame interval
	  and link frequency the Rockchip CSI-2 D-PHY and ISP drivers need.

	  The module is called imx296.
```

## userpatches/camera/kray_adv7180/Kconfig
```kconfig
config VIDEO_KRAY_ADV7180
	tristate "ADV7180/ADV7282-M video decoder support (Kray-SoM-RKC)"
	depends on GPIOLIB && VIDEO_DEV && I2C
	select MEDIA_CONTROLLER
	select VIDEO_V4L2_SUBDEV_API
	help
	  The kernel's adv7180 driver with the link frequency control and the
	  progressive default the Rockchip CSI-2 D-PHY and ISP need, for the
	  ADV7282-M analogue video (CVBS) to MIPI CSI-2 decoder.

	  The module is called kray_adv7180.
```

## userpatches/camera/rpi_dw9807_vcm/Kconfig
```kconfig
config VIDEO_RPI_DW9807_VCM
	tristate "DW9807/DW9817 lens voice coil support (Raspberry Pi driver)"
	depends on I2C && VIDEO_DEV
	select MEDIA_CONTROLLER
	select VIDEO_V4L2_SUBDEV_API
	select V4L2_ASYNC
	help
	  Raspberry Pi's driver for the Dongwoon DW9807 and DW9817 voice coil
	  lens drivers: the focus motors of the Raspberry Pi Camera Module 3
	  and the Arducam 64 MP module. Focus is set with the
	  V4L2_CID_FOCUS_ABSOLUTE control on the lens sub-device.

	  The module is called rpi_dw9807_vcm.
```

## userpatches/camera/rpi_imx258/Kconfig
```kconfig
config VIDEO_RPI_IMX258
	tristate "Sony IMX258 sensor support (Raspberry Pi driver)"
	depends on I2C && VIDEO_DEV
	depends on MEDIA_CAMERA_SUPPORT
	select MEDIA_CONTROLLER
	select VIDEO_V4L2_SUBDEV_API
	select V4L2_FWNODE
	help
	  Raspberry Pi's driver for the Sony IMX258 sensor (2 or 4 MIPI
	  CSI-2 lanes), with the bus configuration and frame interval calls
	  the Rockchip CSI-2 D-PHY and ISP drivers need.

	  The module is called rpi_imx258.
```

## userpatches/camera/rpi_imx290/Kconfig
```kconfig
config VIDEO_RPI_IMX290
	tristate "Sony IMX290/IMX327 sensor support (Raspberry Pi driver)"
	depends on I2C && VIDEO_DEV
	depends on MEDIA_CAMERA_SUPPORT
	select MEDIA_CONTROLLER
	select VIDEO_V4L2_SUBDEV_API
	select V4L2_FWNODE
	select REGMAP_I2C
	help
	  The Sony IMX290/IMX327 driver from Raspberry Pi's kernel (2 or 4
	  MIPI CSI-2 lanes, 1920x1080 and 1280x720, colour and mono IMX290),
	  with the bus configuration, frame interval and Rockchip module
	  information the Rockchip CSI-2 D-PHY and ISP drivers need.

	  The module is called rpi_imx290.
```

## userpatches/camera/rpi_imx335/Kconfig
```kconfig
config VIDEO_RPI_IMX335
	tristate "Sony IMX335 sensor support (Raspberry Pi driver)"
	depends on I2C && VIDEO_DEV
	depends on MEDIA_CAMERA_SUPPORT
	select MEDIA_CONTROLLER
	select VIDEO_V4L2_SUBDEV_API
	select V4L2_FWNODE
	select REGMAP_I2C
	help
	  Raspberry Pi's driver for the Sony IMX335 (2 or 4 MIPI CSI-2
	  lanes, 24 MHz input clock), backported to Linux 6.1, with the bus
	  configuration and frame interval calls the Rockchip CSI-2 D-PHY
	  and ISP drivers need.

	  The module is called rpi_imx335.
```

## userpatches/camera/rpi_mira220/Kconfig
```kconfig
config VIDEO_RPI_MIRA220
	tristate "ams Mira220 sensor support (Raspberry Pi driver)"
	depends on I2C && VIDEO_DEV
	depends on MEDIA_CAMERA_SUPPORT
	select MEDIA_CONTROLLER
	select VIDEO_V4L2_SUBDEV_API
	select V4L2_FWNODE
	select REGMAP_I2C
	help
	  Raspberry Pi's driver for the ams Mira220 global shutter NIR
	  sensor (1600x1400, 2 MIPI CSI-2 lanes, 38.4 MHz input clock),
	  backported to Linux 6.1, with the bus configuration and frame
	  interval calls the Rockchip CSI-2 D-PHY and ISP drivers need.

	  The module is called rpi_mira220.
```

## userpatches/camera/rpi_ov2311/Kconfig
```kconfig
config VIDEO_RPI_OV2311
	tristate "OmniVision OV2311 sensor support (Raspberry Pi driver)"
	depends on I2C && VIDEO_DEV
	depends on MEDIA_CAMERA_SUPPORT
	select MEDIA_CONTROLLER
	select VIDEO_V4L2_SUBDEV_API
	select V4L2_FWNODE
	help
	  Raspberry Pi's driver for the OmniVision OV2311 1600x1300 global
	  shutter monochrome sensor (2 MIPI CSI-2 lanes), with the bus
	  configuration and frame interval calls the Rockchip CSI-2 D-PHY and
	  ISP drivers need.

	  The module is called rpi_ov2311.
```

## userpatches/hailo/kernel/Kconfig
```kconfig
# SPDX-License-Identifier: GPL-2.0
config HAILO_PCI
	tristate "Hailo PCIe AI accelerator (Hailo-8, Hailo-8L, Hailo-8R)"
	depends on PCI
	help
	  Driver for Hailo-8 family AI accelerators on PCIe, from
	  hailo-ai/hailort-drivers. It loads the device firmware from
	  /lib/firmware/hailo and exposes /dev/hailoN to HailoRT.

	  The module is called hailo_pci.
```
